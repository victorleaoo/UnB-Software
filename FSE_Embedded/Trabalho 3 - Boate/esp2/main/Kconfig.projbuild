## FSE_Embedded/Trabalho 3 - Boate/esp2/main/Kconfig.projbuild
```kconfig
menu "Project's Wifi Configuration"

	config ESP_WIFI_SSID
		string "WiFi SSID"
		default "ssid"
		help
			WiFi network's name.

	config ESP_WIFI_PASSWORD
		string "WiFi password"
		default "password"
		help
			WiFi password (WPA or WPA2).

	config ESP_MAXIMUM_RETRY
		int "Maximum connection attempts"
		default 5
		help
			Set the maximum number of connection attempts.
endmenu
```
